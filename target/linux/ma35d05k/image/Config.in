## target/linux/ma35d05k/image/Config.in
```kconfig
if	TARGET_ma35d05k
config MA35D05K_SECURE_BOOT
	bool "MA35D05K Secure Boot"
	default n
	help
	  MA35D05K Secure Boot is a first level bootloader for the MA35D05K
	  devices.

if	MA35D05K_SECURE_BOOT

config MA35D05K_AES_KEY
	string "AES Key"
	default "0A0BC81E5AFBF836C5E0CFBEA12C1E269A2EBC3B0B6EC39EEE1C7142F760EBC4"
	help
	  AES Key

config MA35D05K_ECDSA_KEY
	string "ECDSA Key"
	default "8F1571E9975006A545DF854264F7B18934B5CB2EE619E66DBC0FBEA52C71C919"
	help
          ECDSA Key
endif

config TARGET_SDCARD_DATA_PARTSIZE
	int "SD card rootfs_data (overlay) partition size (in MiB)"
	default 100
	help
	  Size of the writable ext4 "rootfs_data" overlay partition appended
	  to the SD card image. It holds user settings and is preserved across
	  OTA upgrades (squashfs read-only root + ext4 overlay, mirroring the
	  squashfs+ubifs layout used on NAND/SPI-NAND).
	  Set to 0 to disable the overlay and use a writable ext4 root instead.
endif
```
